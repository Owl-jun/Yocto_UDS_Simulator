## yocto/meta-diagnostic/conf/layer.conf
```bitbake
# We have a conf and classes directory, add to BBPATH.
BBPATH .= ":${LAYERDIR}"

# We have recipes-* directories, add to BBFILES.
BBFILES += "${LAYERDIR}/recipes-*/*/*.bb \
            ${LAYERDIR}/recipes-*/*/*.bbappend"

BBFILE_COLLECTIONS += "diagnostic"
BBFILE_PATTERN_diagnostic = "^${LAYERDIR}/"
BBFILE_PRIORITY_diagnostic = "6"

LAYERSERIES_COMPAT_diagnostic = "scarthgap"
```
